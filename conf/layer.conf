## conf/layer.conf
```bitbake
#
# layer profile
#

BBPATH .= ":${LAYERDIR}"

BBFILES += "${LAYERDIR}/recipes-*/*/*.bb \
        ${LAYERDIR}/recipes-*/*/*.bbappend"

BBFILE_COLLECTIONS += "meta-emlinux-flavors"
BBFILE_PATTERN_meta-emlinux-flavors = "^${LAYERDIR}/"
BBFILE_PRIORITY_meta-emlinux-flavors = "50"

LAYERSERIES_COMPAT_meta-emlinux-flavors = "next"

LAYERDIR_meta-emlinux-flavors = "${LAYERDIR}"
```

## conf/machine/qemu-arm64-k3s.conf
```bitbake
#
# SPDX-License-Identifier: MIT
#
DISTRO_ARCH = "arm64"

IMAGE_FSTYPES ?= "ext4"

KERNEL_DEFCONFIG = "qemu-arm64-k3s_defconfig"
```
